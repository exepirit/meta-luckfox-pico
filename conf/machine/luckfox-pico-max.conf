## conf/machine/luckfox-pico-max.conf
```bitbake
require conf/machine/include/rv1106.inc

UBOOT_MACHINE = "rv1106_defconfig"

KERNEL_DEVICETREE ?= "rv1106g-luckfox-pico-max.dtb"

RK_ENV_PART ?= "32K(env),512K@32K(idblock),256K(uboot),32M(boot),1G(rootfs)"
RK_BOOTARGS_CMA_SIZE ?= "66M"
```

## conf/machine/luckfox-pico-mini.conf
```bitbake
require conf/machine/include/rv1106.inc

UBOOT_MACHINE = "rv1106_defconfig"

KERNEL_DEVICETREE ?= "rv1103g-luckfox-pico-mini.dtb"
SDCARD_ROOTFS ?= "${DEPLOY_DIR_IMAGE}/${IMAGE_NAME}.rootfs.ext4"

RK_ENV_PART ?= "32K(env),512K@32K(idblock),256K(uboot),32M(boot),1G(rootfs)"
RK_BOOTMEDIA ?= "emmc"
```
